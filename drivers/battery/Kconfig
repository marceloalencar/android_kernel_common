## drivers/battery/Kconfig
```kconfig
config BATTERY_SAMSUNG
	tristate "samsung battery driver"
	help
	 Say Y to include support for samsung battery driver
	 This battery driver integrated all battery-related functions
	 To see battery-related functions,
	 refer to sec_charging_common.h

config SAMSUNG_LPM_MODE
	bool "Off charging mode support in sec battery driver"
	default n
	help
	 Say Y to include support for sec off charging support
	 This value defiend at bootloader.
	 Before enable this feature,
	 implement power off charging in the bootloader.

# Fuel Gauge

config FUELGAUGE_MFD
	tristate "use mfd driver for fuelgauge driver"
	default n
	depends on BATTERY_SAMSUNG
	help
	 Say Y to include support
	 for fuelgauge driver with mfd.
	 This driver source code implemented
	 fuelgauge driver with mfd.

config FUELGAUGE_88PM822
	tristate "Marvell 88PM822 fuel gauge driver"
	depends on MFD_88PM822
	help
	  Say Y here to enable battery monitor for Marvell 88PM822 chip.
	  This driver uses the ADC function of 88PM822. The capacity of the
	  battery is calculated via the voltage
	  
# Charger

config CHARGER_MFD
	tristate "use mfd driver for charger driver"
	default n
	depends on BATTERY_SAMSUNG
	help
	 Say Y to include support
	 for charger driver with mfd.
	 This driver source code implemented
	 charger driver with mfd.

config CHARGER_SMB328
	tristate "SMB328 charger driver"
	default n
	depends on BATTERY_SAMSUNG
	help
	 Say Y to include support
	 for Summit SMB328 charger driver.
	 This driver source code implemented
	 all functions for SMB328 charger.
```

## drivers/sensor/Kconfig
```kconfig
#
# Sensor  drivers configuration
#
menuconfig SENSORS_SYMLINK_CORE
	bool "Sensor devices"
	help
	  Say Y here, and a list of sensors drivers will be displayed.
	  Everything that didn't fit into the other categories is here. This option
	  doesn't affect the kernel.

	  If unsure, say Y.

if SENSORS_SYMLINK_CORE

config SENSOR_DIR
	bool "sensors_dir"
	depends on I2C

config SENSORS_ACCELOMETER_BMA25X
	depends on I2C
	tristate "BOSCH acceleromter sensor driver"
	default n
	help
	  Say Y here if you use GP2A_PROXIMITY.
	  This option enables proximity sensors using
	  SHARP GP2A_ANALOG device driver.

	  Say N here if you do not use GP2A_ANALOG.

config SENSOR_USE_SYMLINK
	bool "sensors_symlink"
	depends on I2C

endif
```

## drivers/switch/Kconfig
```kconfig
menuconfig SWITCH
	tristate "Switch class support"
	help
	  Say Y here to enable switch class support. This allows
	  monitoring switches by userspace via sysfs and uevent.

if SWITCH

config SWITCH_GPIO
	tristate "GPIO Swith support"
	depends on GPIOLIB
	help
	  Say Y here to enable GPIO based switch support.

config SAMSUNG_JACK
	bool "3.5MM ear jack KSND driver for Samsung devices on Marvell PXA986"
	depends on GPIOLIB && MFD_88PM822
	help
	  Say Y here to enable headset & hook switch support.

endif # SWITCH
```
